## conf/layer.conf
```bitbake
# We have a conf and classes directory, add to BBPATH
BBPATH .= ":${LAYERDIR}"

# We have recipes-* directories, add to BBFILES
BBFILES += "${LAYERDIR}/recipes-*/*/*.bb \
            ${LAYERDIR}/recipes-*/*/*.bbappend"

BBFILE_COLLECTIONS += "meta-seeed-stm32mp135"
BBFILE_PATTERN_meta-seeed-stm32mp135 = "^${LAYERDIR}/"
BBFILE_PRIORITY_meta-seeed-stm32mp135 = "6"

LAYERDEPENDS_meta-seeed-stm32mp135 = "core"
LAYERSERIES_COMPAT_meta-seeed-stm32mp135 = "dunfell"

DISTRO_FEATURES_append = " opengl wayland "

#
# For support meta-seeed-stm32mp135 layer
#
#

# Add device tree file to support ODYSSEY-NPi som
STM32MP_DT_FILES_ODYSSEY_NPI += "stm32mp157c-odyssey"
STM32MP_DEVICETREE_append += " ${STM32MP_DT_FILES_ODYSSEY_NPI} "


# UBOOT_EXTLINUX_TARGETS_EXTRA_CONFIG_target-sdcard += "${STM32MP_DT_FILES_ODYSSEY_NPI}"

DEVICE_BOARD_ENABLE_SDCARD += "${@bb.utils.contains('BOOTDEVICE_LABELS', 'sdcard', '${STM32MP_DT_FILES_ODYSSEY_NPI}', '', d)}"
```
